#include <stdio.h>
#include "esp_log.h"
#include "driver/i2s_std.h"
#include "freertos/FreeRTOS.h"
#include "freertos/task.h"
#include "audio.h"
#include <math.h>
#include "errors.h"

static const char *TAG = "AUDIO";

i2s_chan_handle_t tx_chan;

#define SAMPLE_RATE 44100
#define TONE_FREQUENCY 440
#define PI 3.14159265

esp_err_t audio_test() {
  ESP_LOGI(TAG, "Testing audio");

  int samples_per_cycle = SAMPLE_RATE / TONE_FREQUENCY;
  // Allocate buffer for one period of the sine wave
  int16_t* sine_wave_data = malloc(samples_per_cycle * sizeof(int16_t));

  // Generate the sine wave data
  for (int i = 0; i < samples_per_cycle; i++) {
      sine_wave_data[i] = (int16_t)(32767 * sin(2 * PI * i / samples_per_cycle));
  }

  // /* Enable the TX channel */
  ESP_ERROR_CHECK(i2s_channel_enable(tx_chan));

  size_t bytes_written;
  int limit = 1000;
  int count = 0;
  while (count < limit) {
    // Write the sine wave data to I2S
    if (i2s_channel_write(tx_chan, sine_wave_data, samples_per_cycle * sizeof(int16_t), &bytes_written, 1000) == ESP_OK) {
      printf("Write Task: i2s write %d bytes\n", bytes_written);
    } else {
      printf("Write Task: i2s write failed\n");
    }
    count++;
    vTaskDelay(pdMS_TO_TICKS(10));
  }

  // /* Disable the TX channel */
  ESP_ERROR_CHECK(i2s_channel_disable(tx_chan));

  // Free the sine wave data buffer
  free(sine_wave_data);
  ESP_LOGI(TAG, "Audio test complete");
  return ESP_OK;
}

esp_err_t audio_init() {
  ESP_LOGI(TAG, "Initializing audio");

  i2s_chan_config_t tx_chan_cfg = I2S_CHANNEL_DEFAULT_CONFIG(I2S_NUM_AUTO, I2S_ROLE_MASTER);
  ESP_ERROR_CHECK(i2s_new_channel(&tx_chan_cfg, &tx_chan, NULL));
  /* Step 2: Setting the configurations of standard mode, and initialize rx & tx channels
    * The slot configuration and clock configuration can be generated by the macros
    * These two helper macros is defined in 'i2s_std.h' which can only be used in STD mode.
    * They can help to specify the slot and clock configurations for initialization or re-configuring */
  i2s_std_config_t std_cfg = {
      .clk_cfg  = I2S_STD_CLK_DEFAULT_CONFIG(16000),
      .slot_cfg = I2S_STD_MSB_SLOT_DEFAULT_CONFIG(I2S_DATA_BIT_WIDTH_16BIT, I2S_SLOT_MODE_STEREO),
      .gpio_cfg = {
          .mclk = I2S_GPIO_UNUSED,    // some codecs may require mclk signal, this example doesn't need it
          .bclk = BITCLOCK,
          .ws   = LRCONTROL,
          .dout = DATA,
          .din  = I2S_GPIO_UNUSED, // In duplex mode, bind output and input to a same gpio can loopback internally
          .invert_flags = {
              .mclk_inv = false,
              .bclk_inv = false,
              .ws_inv   = false,
          },
      },
  };
  /* Initialize the channels */
  ESP_ERROR_CHECK(i2s_channel_init_std_mode(tx_chan, &std_cfg));
  return ESP_OK;
}
